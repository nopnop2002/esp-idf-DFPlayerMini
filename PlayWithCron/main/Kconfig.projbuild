## PlayWithCron/main/Kconfig.projbuild
```kconfig
menu "Application Configuration"

	menu "WiFi Setting"

		config ESP_WIFI_SSID
			string "WiFi SSID"
			default "myssid"
			help
				SSID (network name) to connect to.

		config ESP_WIFI_PASSWORD
			string "WiFi Password"
			default "mypassword"
			help
				WiFi password (WPA or WPA2) to use.

		config ESP_MAXIMUM_RETRY
			int "Maximum retry"
			default 5
			help
				Set the Maximum retry to avoid station reconnecting to the AP unlimited when the AP is really inexistent.

	endmenu

	menu "NTP Setting"

		config NTP_SERVER
			string "Hostname for NTP Server"
			default "pool.ntp.org"
			help
				Hostname for NTP Server.

		config LOCAL_TIMEZONE
			int "Your local timezone"
			range -23 23
			default 0
			help
				Your local timezone.  When it is 0, Greenwich Mean Time.

	endmenu

endmenu
```

## PlayWithGpio/main/Kconfig.projbuild
```kconfig
menu "Application configuration"

	config GPIO_RANGE_MAX
		int
		default 33 if IDF_TARGET_ESP32
		default 46 if IDF_TARGET_ESP32S2
		default 48 if IDF_TARGET_ESP32S3
		default 18 if IDF_TARGET_ESP32C2
		default 19 if IDF_TARGET_ESP32C3

	config GPIO_INPUT
		int "GPIO number (GPIOxx) for input"
		range 0 GPIO_RANGE_MAX
		default 0 if IDF_TARGET_ESP32
		default 0 if IDF_TARGET_ESP32S2 || IDF_TARGET_ESP32S3
		default 9 if IDF_TARGET_ESP32C2 || IDF_TARGET_ESP32C3
		help
			GPIO number (IOxx) for Input.
			Some GPIOs are used for other purposes (flash connections, etc.) and cannot be used to Button.

	choice GPIO_INITIAL
		prompt "GPIO Initial state"
		default GPIO_PULLUP
		help
			Select initial state of GPIO.

		config GPIO_PULLUP
			bool "GPIO_PULLUP"
			help
				The initial state of GPIO is Pull-UP.

		config GPIO_PULLDOWN
			bool "GPIO_PULLDOWN"
			help
				The initial state of GPIO is Pull-Down.

	endchoice

endmenu
```

## PlayWithMQTT/main/Kconfig.projbuild
```kconfig
menu "Application Configuration"

	menu "WiFi Setting"

		config ESP_WIFI_SSID
			string "WiFi SSID"
			default "myssid"
			help
				SSID (network name) to connect to.

		config ESP_WIFI_PASSWORD
			string "WiFi Password"
			default "mypassword"
			help
				WiFi password (WPA or WPA2) to use.

		config ESP_MAXIMUM_RETRY
			int "Maximum retry"
			default 5
			help
				Set the Maximum retry to avoid station reconnecting to the AP unlimited when the AP is really inexistent.

	endmenu

	menu "Broker Setting"

		config BROKER_URL
			string "Broker URL"
			default "mqtt://broker.emqx.io"
			help
				URL of the broker to connect to

		config MQTT_SUB_TOPIC
			string "Subscribe Topic"
			default "/topic/dfplay/#"
			help
				Topic of subscribe

	endmenu

endmenu
```

## PlayWithUDP/main/Kconfig.projbuild
```kconfig
menu "Application Configuration"


	config ESP_WIFI_SSID
		string "WiFi SSID"
		default "myssid"
		help
			SSID (network name) to connect to.

	config ESP_WIFI_PASSWORD
		string "WiFi Password"
		default "mypassword"
		help
			WiFi password (WPA or WPA2) to use.

	config ESP_MAXIMUM_RETRY
		int "Maximum retry"
		default 5
		help
			Set the Maximum retry to avoid station reconnecting to the AP unlimited when the AP is really inexistent.

	config MDNS_HOSTNAME
		string "mDNS Hostname"
		default "esp32-server"
		help
			The mDNS host name used by the ESP32.

	config UDP_PORT
		int "UDP Port"
		range 0 65535
		default 9876
		help
			Local port UDP server will listen on.

endmenu
```
