## components/DFRobotDFPlayerMini/Kconfig.projbuild
```kconfig
menu "DFPlayerMini Configuration"

	config TX_GPIO
		int "TX GPIO number"
		range 0 SOC_GPIO_OUT_RANGE_MAX
		default 4
		help
			GPIO number (IOxx) to CTX.
			Some GPIOs are used for other purposes (flash connections, etc.).
			GPIOs 35-39 are input-only so cannot be used as outputs.

	config RX_GPIO
		int "RX GPIO number"
		range 0 SOC_GPIO_IN_RANGE_MAX
		default 5
		help
			GPIO number (IOxx) to CRX.
			Some GPIOs are used for other purposes (flash connections, etc.).
			GPIOs 35-39 are input-only so cannot be used as outputse

	config DEBUG_MODE
		bool "Enable Debug Mode"
		default false
		help
			Enable Debug Mode.

endmenu
```
